 /dts-v1/;  
 /plugin/;  
 
 / {  
   compatible = "ti,beaglebone", "ti,beaglebone-green", "ti,beaglebone-black", "ti,beaglebone-green-wireless";   
   part-number = "PRU-SWAMP-ADC";  
   version = "00A0";  
   exclusive-use = "P8.12", "P8.11", "P8.16", "P8.45", "pru0", "pru1";  
   
   fragment@0 {  
    target = <&am33xx_pinmux>;  
    __overlay__ {  
      spi_pins: pinmux_pru_pru_pins {  
       pinctrl-single,pins = <  
         0x30 0x05
         0x34 0x05
         0x38 0x26  
         0xA0 0x05  
       >;  
      };  
    };  
   };  
   
   fragment@1 {  
    target = <&pruss>;  
    __overlay__ {  
      status = "okay";  
      pinctrl-names = "default";  
      pinctrl-0 = <&spi_pins>;  
    };  
   };  
 };  
