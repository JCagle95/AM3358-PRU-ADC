/dts-v1/;
/plugin/;

/ {
    compatible = "ti,beaglebone", "ti,beaglebone-black";

    /* identification */
    part-number = "PRU-ENABLE"; 

    /* version */
    version = "00A0";

        fragment@1 {         // Enable the PRUSS
                target = <&pruss>;
                __overlay__ {
                    status = "okay";
                };
        };
};
